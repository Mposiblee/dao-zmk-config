## config/boards/arm/dao/Kconfig.defconfig
```kconfig
# Copyright (c) 2021 Rafael Yumagulov
# SPDX-License-Identifier: MIT

if BOARD_DAO_DONGLE

config ZMK_KEYBOARD_NAME
	default "Dao"

config ZMK_SPLIT_BLE_ROLE_CENTRAL
	default y

config ZMK_USB
	defautl y

endif # BOARD_DAO_LEFT

if BOARD_DAO_LEFT || BOARD_DAO_RIGHT || BOARD_DAO_DONGLE


config ZMK_SPLIT
	default y

config ZMK_BLE
	default y
	
endif
```
