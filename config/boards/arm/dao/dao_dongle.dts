/*
 * Copyright (c) 2021 Rafael Yumagulov
 *
 * SPDX-License-Identifier: MIT
 */

#include "dao.dtsi"

&kscan0 {
	col-gpios
		= <&gpio0 29 GPIO_ACTIVE_HIGH>
		, <&gpio1  15 GPIO_ACTIVE_HIGH>
		, <&gpio0  04 GPIO_ACTIVE_HIGH>
		, <&gpio0 05 GPIO_ACTIVE_HIGH>
		, <&gpio1 14 GPIO_ACTIVE_HIGH>
		, <&gpio1 13 GPIO_ACTIVE_HIGH>
		;
};
